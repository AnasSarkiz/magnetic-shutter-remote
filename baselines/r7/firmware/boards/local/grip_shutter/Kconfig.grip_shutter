## baselines/r7/firmware/boards/local/grip_shutter/board.yml
```yaml
board:
  name: grip_shutter
  full_name: Magnetic shutter remote R1 E73-2G4M08S1C
  vendor: others
  socs:
    - name: nrf52840
```
